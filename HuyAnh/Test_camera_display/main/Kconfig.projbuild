## HuyAnh/Test_camera_display/main/Kconfig.projbuild
```kconfig
menu "ST7789 Configuration"
    choice ESPNOW_WIFI_MODE
        prompt "WiFi mode"
        default ESPNOW_WIFI_MODE_STATION
        help
            WiFi mode(station or softap).

        config ESPNOW_WIFI_MODE_STATION
            bool "Station"
        config ESPNOW_WIFI_MODE_STATION_SOFTAP
            bool "Softap"
    endchoice

    config ESPNOW_PMK
        string "ESPNOW primary master key"
        default "pmk1234567890123"
        help
            ESPNOW primary master for the example to use. The length of ESPNOW primary master must be 16 bytes.

    config ESPNOW_LMK
        string "ESPNOW local master key"
        default "lmk1234567890123"
        help
            ESPNOW local master for the example to use. The length of ESPNOW local master must be 16 bytes.

    config ESPNOW_CHANNEL
        int "Channel"
        default 1
        range 1 13
        help
            The channel on which sending and receiving ESPNOW data.

    config ESPNOW_ENABLE_LONG_RANGE
        bool "Enable Long Range"
        default "n"
        help
            When enable long range, the PHY rate of ESP32 will be 512Kbps or 256Kbps

	config INVERSION
		bool "Enable Display Inversion"
		default false
		help
			Enable Display Inversion.

	config OV7670_SUPPORT
        bool "Support OV7670 VGA"
        default y
        help
            Enable this option if you want to use the OV7670.
            Disable this option to safe memory.

    config OV7725_SUPPORT
        bool "Support OV7725 SVGA"
        default n
        help
            Enable this option if you want to use the OV7725.
            Disable this option to save memory.

    config NT99141_SUPPORT
        bool "Support NT99141 HD"
        default y
        help
            Enable this option if you want to use the NT99141.
            Disable this option to save memory.

    config OV2640_SUPPORT
        bool "Support OV2640 2MP"
        default y
        help
            Enable this option if you want to use the OV2640.
            Disable this option to save memory.

    config OV3660_SUPPORT
        bool "Support OV3660 3MP"
        default y
        help
            Enable this option if you want to use the OV3360.
            Disable this option to save memory.

    config OV5640_SUPPORT
        bool "Support OV5640 5MP"
        default y
        help
            Enable this option if you want to use the OV5640.
            Disable this option to save memory.

    choice SCCB_HARDWARE_I2C_PORT
        bool "I2C peripheral to use for SCCB"
        default SCCB_HARDWARE_I2C_PORT1

        config SCCB_HARDWARE_I2C_PORT0
            bool "I2C0"
        config SCCB_HARDWARE_I2C_PORT1
            bool "I2C1"

    endchoice

    choice CAMERA_TASK_PINNED_TO_CORE
        bool "Camera task pinned to core"
        default CAMERA_CORE0
        help
            Pin the camera handle task to a certain core(0/1). It can also be done automatically choosing NO_AFFINITY.

        config CAMERA_CORE0
            bool "CORE0"
        config CAMERA_CORE1
            bool "CORE1"
        config CAMERA_NO_AFFINITY
            bool "NO_AFFINITY"

    endchoice

endmenu
```

## Test/sdkconfig.defaults
```kconfig
# Override some defaults so BT stack is enabled
# and WiFi disabled by default in this example
CONFIG_BT_ENABLED=y
CONFIG_BTDM_CTRL_MODE_BLE_ONLY=y
CONFIG_BTDM_CTRL_MODE_BR_EDR_ONLY=n
CONFIG_BTDM_CTRL_MODE_BTDM=n

# Increase main task stack size
CONFIG_ESP_MAIN_TASK_STACK_SIZE=7168

# Enable filesystem
CONFIG_PARTITION_TABLE_CUSTOM=y
CONFIG_PARTITION_TABLE_CUSTOM_FILENAME="partitions_example.csv"
CONFIG_PARTITION_TABLE_FILENAME="partitions_example.csv"

# Enable FreeRTOS stats formatting functions, needed for 'tasks' command
CONFIG_FREERTOS_USE_TRACE_FACILITY=y
CONFIG_FREERTOS_USE_STATS_FORMATTING_FUNCTIONS=y

CONFIG_ESPTOOLPY_FLASHSIZE_4MB=y

CONFIG_ESP_NETIF_TCPIP_ADAPTER_COMPATIBLE_LAYER=n
```
